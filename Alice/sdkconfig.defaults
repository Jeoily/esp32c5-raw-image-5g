## Alice/sdkconfig.defaults
```kconfig
CONFIG_IDF_TARGET="esp32c5"
CONFIG_ESPTOOLPY_FLASHSIZE_2MB=y
CONFIG_ESP_CONSOLE_UART_BAUDRATE=921600
CONFIG_PARTITION_TABLE_SINGLE_APP=y
CONFIG_ESP_CONSOLE_UART_CUSTOM=y
CONFIG_ESP_MAIN_TASK_STACK_SIZE=8192
```
